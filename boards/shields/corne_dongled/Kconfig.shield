## boards/shields/corne_dongled/Kconfig.shield
```kconfig
# No whitespace after the comma or in the keyboard name!
config SHIELD_CORNE_DONGLED
    def_bool $(shields_list_contains,corne_dongled)
```

## boards/shields/my_corne_dongled/Kconfig.shield
```kconfig
# No whitespace after the comma or in the keyboard name!
config SHIELD_MY_CORNE_DONGLED
    def_bool $(shields_list_contains,my_corne_dongled)
```
